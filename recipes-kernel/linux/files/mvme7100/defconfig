## recipes-kernel/linux/files/mvme7100/defconfig
```kconfig
CONFIG_HIGHMEM=y
CONFIG_PPC_86xx=y
CONFIG_MVME7100=y

CONFIG_PPC_CHRP=n
CONFIG_PPC_PMAC=n

CONFIG_SMP=y
CONFIG_NR_CPUS=2

CONFIG_ADVANCED_OPTIONS=y
CONFIG_LOWMEM_SIZE_BOOL=y
CONFIG_LOWMEM_SIZE=0x40000000
CONFIG_PAGE_OFFSET_BOOL=y
CONFIG_PAGE_OFFSET=0x80000000
CONFIG_KERNEL_START_BOOL=y
CONFIG_KERNEL_START=0x80000000
CONFIG_PHYSICAL_START=0x00000000
CONFIG_TASK_SIZE_BOOL=y
CONFIG_TASK_SIZE=0x80000000

CONFIG_BROADCOM_PHY=y
CONFIG_GIANFAR=y

CONFIG_I2C=y
CONFIG_I2C_MPC=y

CONFIG_PCI=y
CONFIG_PCIEPORTBUS=y
CONFIG_PCIEAER=y
CONFIG_PCIEASPM=n

CONFIG_SENSORS_LM90=y

CONFIG_SERIAL_8250=y
CONFIG_SERIAL_8250_CONSOLE=y
CONFIG_SERIAL_8250_DETECT_IRQ=y
CONFIG_SERIAL_8250_NR_UARTS=5
CONFIG_SERIAL_8250_RUNTIME_UARTS=5
CONFIG_SERIAL_8250_EXTENDED=y
CONFIG_SERIAL_8250_MANY_PORTS=y
CONFIG_SERIAL_8250_SHARE_IRQ=y

CONFIG_RTC_LIB=y
CONFIG_RTC_CLASS=y
CONFIG_RTC_DRV_DS1307=y

CONFIG_VME_BUS=y
CONFIG_VME_TSI148=m

CONFIG_USB=y
CONFIG_USB_EHCI_HCD=y
CONFIG_USB_OHCI_HCD=y
CONFIG_USB_OHCI_HCD_PPC_OF_BE=y
CONFIG_USB_OHCI_HCD_PPC_OF_LE=y

CONFIG_CMDLINE_BOOL=y
CONFIG_CMDLINE="console=ttyS0,9600 quiet"

CONFIG_MD=n
CONFIG_SECURITY=n

CONFIG_PPC_DISABLE_WERROR=y
CONFIG_PPC_WERROR=n

CONFIG_USB_ACM=y
```
